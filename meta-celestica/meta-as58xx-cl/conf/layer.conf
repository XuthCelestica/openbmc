## meta-celestica/meta-as58xx-cl/conf/layer.conf
```bitbake
# We have a conf and classes directory, add to BBPATH
BBPATH .= ":${LAYERDIR}"

# We have recipes-* directories, add to BBFILES
BBFILES += "${LAYERDIR}/recipes-*/*/*.bb \
	${LAYERDIR}/recipes-*/*/*.bbappend"

BBFILE_COLLECTIONS += "as58xx-cl"
BBFILE_PATTERN_as58xx-cl = "^${LAYERDIR}/"
BBFILE_PRIORITY_as58xx-cl = "22"
```

## meta-celestica/meta-phalanx/conf/layer.conf
```bitbake
# We have a conf and classes directory, add to BBPATH
BBPATH .= ":${LAYERDIR}"

# We have recipes-* directories, add to BBFILES
BBFILES += "${LAYERDIR}/recipes-*/*/*.bb \
	${LAYERDIR}/recipes-*/*/*.bbappend"

BBFILE_COLLECTIONS += "phalanx"
BBFILE_PATTERN_phalanx = "^${LAYERDIR}/"
BBFILE_PRIORITY_phalanx = "22"
```

## meta-facebook/meta-voyager/conf/bblayers.conf
```bitbake
# LAYER_CONF_VERSION is increased each time build/conf/bblayers.conf
# changes incompatibly
LCONF_VERSION = "7"

BBPATH = "${TOPDIR}"
BBFILES ?= ""

BBLAYERS ?= " \
  /home/alexzhang/openbmc/openbmc.voyager2/openbmc/yocto/krogoth/poky/meta \
  /home/alexzhang/openbmc/openbmc.voyager2/openbmc/yocto/krogoth/poky/meta-poky \
  /home/alexzhang/openbmc/openbmc.voyager2/openbmc/yocto/krogoth/poky/meta-yocto-bsp \
  /home/alexzhang/openbmc/openbmc.voyager2/openbmc/yocto/krogoth/poky/../meta-openembedded/meta-oe \
  /home/alexzhang/openbmc/openbmc.voyager2/openbmc/yocto/krogoth/poky/../meta-openembedded/meta-networking \
  /home/alexzhang/openbmc/openbmc.voyager2/openbmc/yocto/krogoth/poky/../meta-openembedded/meta-python \
  /home/alexzhang/openbmc/openbmc.voyager2/openbmc/yocto/krogoth/poky/../../.. \
  /home/alexzhang/openbmc/openbmc.voyager2/openbmc/yocto/krogoth/poky/../../../meta-aspeed \
  /home/alexzhang/openbmc/openbmc.voyager2/openbmc/yocto/krogoth/poky/../../../meta-facebook \
  /home/alexzhang/openbmc/openbmc.voyager2/openbmc/yocto/krogoth/poky/../../../meta-facebook/meta-voyager \
  /home/alexzhang/openbmc/openbmc.voyager2/openbmc/yocto/krogoth/poky/../../../meta-facebook/meta-python3 \
  "
BBLAYERS_NON_REMOVABLE ?= " \
  /home/alexzhang/openbmc/openbmc.voyager2/openbmc/yocto/krogoth/poky/meta \
  /home/alexzhang/openbmc/openbmc.voyager2/openbmc/yocto/krogoth/poky/meta-poky \
  "
```

## meta-facebook/meta-voyager/conf/layer.conf
```bitbake
# We have a conf and classes directory, add to BBPATH
BBPATH .= ":${LAYERDIR}"

# We have recipes-* directories, add to BBFILES
BBFILES += "${LAYERDIR}/recipes-*/*/*.bb \
	${LAYERDIR}/recipes-*/*/*.bbappend"

BBFILE_COLLECTIONS += "voyager"
BBFILE_PATTERN_voyager = "^${LAYERDIR}/"
BBFILE_PRIORITY_voyager = "21"
```

## meta-facebook/meta-voyager/conf/local.conf
```bitbake
#
# Local configuration file for building the OpenBMC image.
#

# Machine Selection
MACHINE ??= "voyager"

# OpenBMC distro settings
DISTRO ?= "openbmc-fb"
```
